## config/defconfig
```kconfig
# Minimal OpenWrt defconfig seed for THG6500-TAX2 (generic).
# Regenerate base: ./scripts/diffconfig.sh > config/defconfig
# THG6500 USB/TUN/LXC/omcproxy rules: config/defconfig.fragment (auto-merged by make defconfig)

CONFIG_TARGET_tr6560=y
CONFIG_TARGET_tr6560_generic=y
CONFIG_TARGET_tr6560_generic_DEVICE_THG6500-TAX2=y
CONFIG_BUSYBOX_CUSTOM=y
CONFIG_BUSYBOX_CONFIG_FEATURE_GETOPT_LONG=y
CONFIG_BUSYBOX_CONFIG_FEATURE_SEAMLESS_XZ=y
CONFIG_BUSYBOX_CONFIG_FEATURE_TAR_LONG_OPTIONS=y
CONFIG_BUSYBOX_CONFIG_GETOPT=y
CONFIG_BUSYBOX_CONFIG_MOUNTPOINT=y
CONFIG_BUSYBOX_CONFIG_UNXZ=y
CONFIG_BUSYBOX_CONFIG_XZ=y
CONFIG_KERNEL_DEVTMPFS=y
CONFIG_KERNEL_DEVTMPFS_MOUNT=y
CONFIG_LIBCURL_CRYPTO_AUTH=y
CONFIG_PACKAGE_TAR_BZIP2=y
CONFIG_PACKAGE_TAR_GZIP=y
CONFIG_PACKAGE_TAR_XZ=y
CONFIG_PACKAGE_TAR_ZSTD=y
CONFIG_PACKAGE_bzip2=y
CONFIG_PACKAGE_flock=y
CONFIG_PACKAGE_i2c-tools=y
CONFIG_PACKAGE_kmod-ikconfig=y
CONFIG_PACKAGE_kmod-macvlan=y
CONFIG_PACKAGE_kmod-nls-base=y
CONFIG_PACKAGE_kmod-tun=m
CONFIG_PACKAGE_kmod-usb-serial=m
CONFIG_PACKAGE_kmod-usb-serial-ch341=m
CONFIG_PACKAGE_kmod-usb-serial-cp210x=m
CONFIG_PACKAGE_kmod-usb-serial-pl2303=m
CONFIG_PACKAGE_kmod-veth=y
CONFIG_PACKAGE_libbz2=y
CONFIG_PACKAGE_libcap=y
CONFIG_PACKAGE_libevdev=y
CONFIG_PACKAGE_libi2c=y
CONFIG_PACKAGE_libkmod=y
CONFIG_PACKAGE_liblzma=y
CONFIG_PACKAGE_libpci=y
CONFIG_PACKAGE_libseccomp=y
CONFIG_PACKAGE_libudev-zero=y
CONFIG_PACKAGE_libusb-1.0=y
CONFIG_PACKAGE_libzstd=y
# CONFIG_PACKAGE_nand-utils is not set
CONFIG_PACKAGE_openssh-client=y
CONFIG_PACKAGE_openssh-client-utils=y
CONFIG_PACKAGE_openssh-keygen=y
CONFIG_PACKAGE_pciids=y
CONFIG_PACKAGE_pciutils=y
CONFIG_PACKAGE_sshpass=y
CONFIG_PACKAGE_strace=y
CONFIG_PACKAGE_tar=y
# CONFIG_PACKAGE_tr5220-eFEM-tr6560 is not set
CONFIG_PACKAGE_tr5220-iFEM-tr6560=y
# CONFIG_PACKAGE_udhcpsnoop is not set
CONFIG_PACKAGE_usbids=y
CONFIG_PACKAGE_usbutils=y
CONFIG_PACKAGE_xz=y
CONFIG_PACKAGE_xz-utils=y
CONFIG_ZSTD_OPTIMIZE_O3=y
```
